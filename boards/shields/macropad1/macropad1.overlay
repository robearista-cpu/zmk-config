// This file was generated from a template. Edit it to match your keyboard.
// See https://zmk.dev/docs/development/hardware-integration/new-shield for more
// instructions.

#include <dt-bindings/zmk/matrix_transform.h>

/ {
    chosen {
        zmk,kscan = &kscan0;
    };

    kscan0: kscan {
        compatible = "zmk,kscan-gpio-direct";
        input-gpios = <&gpio0 0 GPIO_ACTIVE_LOW>,
                     <&gpio0 1 GPIO_ACTIVE_LOW>,
                     <&gpio0 2 GPIO_ACTIVE_LOW>,
                     <&gpio0 3 GPIO_ACTIVE_LOW>,
                     <&gpio0 4 GPIO_ACTIVE_LOW>,
                     <&gpio0 5 GPIO_ACTIVE_LOW>;
    };
};